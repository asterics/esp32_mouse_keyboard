## main/Kconfig.projbuild
```kconfig
menu "esp32_mouse_keyboard / FLipMouse & FABI config"
	config USE_AS_FLIPMOUSE_FABI
		bool "Use project as FLipMouse/FABI Bluetooth module"
		default n
		help
			If this option is enabled, a FLipMouse/FABI Bluetooth module
			is built. If disabled, this project acts as demo code for Bluetooth
			HID code.
      
  menu "Select device"
    visible if USE_AS_FLIPMOUSE_FABI
    choice MODULE_TYPE
        prompt "Module type"
        help
            Specify the module type (Arduino Nano RP2040 Connect or esp32miniBT module).
            
        config MODULE_MINIBT
            bool "esp32miniBT module"

        config MODULE_NANO
            bool "Arduino Nano Connect RP2040 with uBlox Nina"
        endchoice
  endmenu
  
	menu "Pinning for UART RX/TX & LED (if not a defined module)"
		visible if !USE_AS_FLIPMOUSE_FABI
		
		config MODULE_RX_PIN
			int "RX pin for command/HID UART"
			default 17
			range 1 39
			
		config MODULE_TX_PIN
			int "TX pin for command/HID UART"
			default 16
			range 1 39
			
		config MODULE_LED_PIN
			int "LED connection indicator pin"
			default 5
			range 1 39
		
		config MODULE_UART_NR
			int "UART interface number"
			default 2
			range 1 2
	endmenu
	config MODULE_USEKEYBOARD
		bool "Enable BLE-HID keyboard (UNUSED, mouse is always enabled)"
		default y
		help
			Enable the Keyboard interface for Bluetooth.
			
	config MODULE_USEMOUSE
		depends on MODULE_USEKEYBOARD
		bool "Enable BLE-HID mouse (UNUSED, kbd is always enabled)"
		default y
		help
			Enable the Mouse interface for Bluetooth.
			
	config MODULE_USEABSOLUTEMOUSE
		depends on MODULE_USEMOUSE
		bool "Use absolute mouse instead of classic relative mouse (UNUSED)"
		default n
		help
			If enabled, the normal relative mouse is replaced with an
			absolute mouse descriptor. Please note, that a different mouse
			input data is used if enabled (we need int16_t for x and y).
			
	config MODULE_USEJOYSTICK
		depends on MODULE_USEMOUSE
		bool "Enable BLE-HID joystick"
		default y
		help
			Enable the Joystick interface for Bluetooth.
			
	config MODULE_BT_PAIRING
		bool "Disable pairing by default, enabled by command"
		default n
		help
			If enabled, the module denies pairing requests by default.
			It is possible to enable the pairing by sending the pairing en-/disable command
			via the serial interface.
endmenu
```

## sdkconfig.defaults
```kconfig
# Override some defaults so BT stack is enabled
# by default in this example
CONFIG_BT_ENABLED=y
CONFIG_BTDM_CTRL_MODE_BLE_ONLY=y
CONFIG_BTDM_CTRL_MODE_BR_EDR_ONLY=n
CONFIG_BTDM_CTRL_MODE_BTDM=n

# for testing with ESP32Think (Sparkfun), which has a different XTAl
CONFIG_ESP32_XTAL_FREQ_AUTO=y
CONFIG_ESP32_XTAL_FREQ=0

# ESP32-WROOM uses 4MB
CONFIG_ESPTOOLPY_FLASHSIZE_4MB=y
CONFIG_ESPTOOLPY_FLASHSIZE="4MB"
CONFIG_ESPTOOLPY_FLASHSIZE_DETECT=y

# flash with 921k by default
CONFIG_ESPTOOLPY_BAUD_921600B=y
CONFIG_ESPTOOLPY_BAUD=921600
```
